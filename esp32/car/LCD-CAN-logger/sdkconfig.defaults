## esp32/car/LCD-CAN-logger/sdkconfig.defaults
```kconfig
CONFIG_SPIRAM=y
CONFIG_SPIRAM_MODE_OCT=y
CONFIG_SPIRAM_SPEED_80M=y

CONFIG_LV_USE_USER_DATA=y
CONFIG_LV_USE_CHART=n
CONFIG_LV_USE_PERF_MONITOR=n

CONFIG_ESPTOOLPY_FLASHSIZE_4MB=y
CONFIG_PARTITION_TABLE_CUSTOM=y


# CONFIG_LV_FONT_MONTSERRAT_34 is not set
# CONFIG_LV_FONT_MONTSERRAT_36 is not set
# CONFIG_LV_FONT_MONTSERRAT_38 is not set
CONFIG_LV_CONF_SKIP=y
CONFIG_LV_CONF_MINIMAL=y
CONFIG_LV_FONT_MONTSERRAT_40=y
CONFIG_LV_FONT_MONTSERRAT_20=y
CONFIG_LV_FONT_DEFAULT_MONTSERRAT_20=y 
CONFIG_LV_USE_DEMO_WIDGETS=n
CONFIG_LV_BUILD_EXAMPLES=n
```

## esp32/car/can_speed_control/main/Kconfig.projbuild
```kconfig
menu "CAN Speed Config"

config AP_PASSWORD
    string "WiFi AP password"
    default "swift1234"
    help
        Password for the "Swift" WiFi access point (min 8 chars for WPA2).
        Leave empty for an open (no-password) network.

endmenu
```

## esp32/examples/mazy-test-sht21/main/Kconfig.projbuild
```kconfig
menu "Mazy's IOT Config"

      config ESP_WIFI_SSID
              string "WiFi SSID"
              default "HomeSweetHome"
              help
                  SSID (network name) for the example to connect to.

      config ESP_WIFI_PASSWORD
              string "WiFi Password"
              default "testme1ONE"
              help
                  WiFi password (WPA or WPA2) for the example to use.

      config ESP_LED_GPIO
              int "Set the GPIO for the LED"
              default 8
              help
                  The GPIO number the LED is connected to.

      config ESP_SETUP_CODE
              string "HomeKit Setup Code"
              default "338-77-883"
              help
                  If you want to change the HomeKit Setup Code, you can do that here (Note:  you need to make a new QR-CODE To make it work)

      config ESP_SETUP_ID
              string "HomeKit Setup ID"
              default "1QJ8"
              help
                   If you want to change the HomeKit Setup ID, you can do that here (Note: you need to make a new QR-CODE To make it work)


    config I2C_MASTER_SCL
        int "SCL GPIO Num"
        default 9 if IDF_TARGET_ESP32C3
        default 19 if IDF_TARGET_ESP32 || IDF_TARGET_ESP32S2 || IDF_TARGET_ESP32S3
        help
            GPIO number for I2C Master clock line.

    config I2C_MASTER_SDA
        int "SDA GPIO Num"
        default 8 if IDF_TARGET_ESP32C3
        default 18 if IDF_TARGET_ESP32 || IDF_TARGET_ESP32S2 || IDF_TARGET_ESP32S3
        help
            GPIO number for I2C Master data line.

endmenu
```

## esp32/home/mazy-iot-sensor/sdkconfig.defaults
```kconfig
#
# StudioPieters
#

CONFIG_PARTITION_TABLE_CUSTOM=y
CONFIG_PARTITION_TABLE_CUSTOM_CSV_PATH="partitions.csv"


# General Optimization
CONFIG_COMPILER_OPTIMIZATION_SIZE=y


# Binary Size Reduction
CONFIG_ESP_CONSOLE_UART_DEFAULT=y

# RAM Usage Minimization
# CONFIG_FREERTOS_IDLE_TASK_STACKSIZE=512
# CONFIG_FREERTOS_ISR_STACKSIZE=1536
CONFIG_HEAP_POISONING_DISABLED=y
CONFIG_HEAP_TRACING_OFF=y

#
# HomeKit
#
CONFIG_HOMEKIT_MAX_CLIENTS=16
CONFIG_HOMEKIT_SMALL=y
CONFIG_HOMEKIT_DEBUG=n
# end of HomeKit

#
# wolfSSL
#
CONFIG_WOLFSSL_APPLE_HOMEKIT=y
CONFIG_WOLFSSL_HW_AES=n
CONFIG_WOLFSSL_HW_SHA=n
CONFIG_WOLFSSL_HW_RSA=n
CONFIG_WOLFSSL_HW_ECC=n
CONFIG_WOLFSSL_HW_MATH_ENABLED=n
CONFIG_ESP_MAIN_TASK_STACK_SIZE=10500


# logg
#
# Log
#
CONFIG_BOOTLOADER_LOG_VERSION_2=y
CONFIG_BOOTLOADER_LOG_VERSION=2
# CONFIG_BOOTLOADER_LOG_LEVEL_NONE is not set
# CONFIG_BOOTLOADER_LOG_LEVEL_ERROR is not set
# CONFIG_BOOTLOADER_LOG_LEVEL_WARN is not set
CONFIG_BOOTLOADER_LOG_LEVEL_INFO=y
# CONFIG_BOOTLOADER_LOG_LEVEL_DEBUG is not set
# CONFIG_BOOTLOADER_LOG_LEVEL_VERBOSE is not set
CONFIG_BOOTLOADER_LOG_LEVEL=3

#
# Format
#
# CONFIG_BOOTLOADER_LOG_COLORS is not set
# CONFIG_BOOTLOADER_LOG_COLORS_SUPPORT is not set
# CONFIG_BOOTLOADER_LOG_TIMESTAMP_SOURCE_NONE is not set
CONFIG_BOOTLOADER_LOG_TIMESTAMP_SOURCE_CPU_TICKS=y
CONFIG_BOOTLOADER_LOG_TIMESTAMP_SUPPORT=y
# end of Format

#
# Settings
#
CONFIG_BOOTLOADER_LOG_MODE_TEXT_EN=y
CONFIG_BOOTLOADER_LOG_MODE_TEXT=y
# CONFIG_BOOTLOADER_LOG_MODE_BINARY is not set
# end of Settings
# end of Log

CONFIG_I2C_MASTER_ISR_HANDLER_IN_IRAM=y

# ESP-Driver:UART Configurations
#
CONFIG_UART_ISR_IN_IRAM=y
# end of ESP-Driver:UART Configurations

CONFIG_ESP_WIFI_SSID="***"
CONFIG_ESP_WIFI_PASSWORD="***"
CONFIG_ESP_WIFI_STA_DISCONNECTED_PM_ENABLE=n
CONFIG_ESP_WIFI_ENABLE_WPA3_SAE=n
CONFIG_ESP_WIFI_ENABLE_SAE_PK=n
CONFIG_ESP_WIFI_ENABLE_SAE_H2E=n
CONFIG_PM_ENABLE=n
```
